## firmware/composter-mcu/sdkconfig.defaults
```kconfig
CONFIG_IDF_TARGET="esp32s3"
CONFIG_FREERTOS_HZ=1000
CONFIG_TINYUSB_CDC_ENABLED=y
CONFIG_ESP32_WIFI_ENABLED=n
CONFIG_BT_ENABLED=n
```

## firmware/safety-mcu/sdkconfig.defaults
```kconfig
CONFIG_IDF_TARGET="esp32s3"
CONFIG_FREERTOS_HZ=1000
CONFIG_TINYUSB_CDC_ENABLED=y
CONFIG_ESP32_WIFI_ENABLED=n
CONFIG_BT_ENABLED=n
CONFIG_ESP_TASK_WDT_INIT=y
CONFIG_ESP_TASK_WDT_TIMEOUT_S=1
CONFIG_ESP_INT_WDT=y
```

## firmware/sensor-mcu/sdkconfig.defaults
```kconfig
CONFIG_IDF_TARGET="esp32s3"
CONFIG_FREERTOS_HZ=1000

# USB-CDC link to Jetson
CONFIG_TINYUSB_CDC_ENABLED=y
CONFIG_TINYUSB_CDC_RX_BUFSIZE=512
CONFIG_TINYUSB_CDC_TX_BUFSIZE=512

# Air-gap discipline: wireless radios off in firmware
CONFIG_ESP32_WIFI_ENABLED=n
CONFIG_BT_ENABLED=n

# Watchdog
CONFIG_ESP_TASK_WDT_INIT=y
CONFIG_ESP_TASK_WDT_TIMEOUT_S=5
CONFIG_ESP_INT_WDT=y
```
